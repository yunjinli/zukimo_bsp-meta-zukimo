## conf/distro/zukidemo.conf
```bitbake
DISTRO = "zukidemo"
DISTRO_NAME = "Zukimo Demonstration Distro"
DISTRO_VERSION_BASE = "0.0.1"
DISTRO_VERSION = "${DISTRO_VERSION_BASE}+snapshot-${METADATA_REVISION}"
DISTRO_CODENAME = "nanbield"

# Configure name and options of the SDK
SDK_NAME = "${DISTRO}-${TCLIBC}-${SDK_ARCH}-${IMAGE_BASENAME}-${TUNE_PKGARCH}"
SDK_VERSION_PART = "0.0.1"
SDK_VERSION = "${SDK_VERSION_PART}-${DATE}"
SDK_VERSION[vardepsexclude] = "DATE"
SDKPATH = "/opt/yocto/${DISTRO}/${SDK_VERSION_PART}"
SDKPATHINSTALL = "${SDKPATH}"

# New ${DISTRO}-<version> setting for sanity checks.
# Increment version number (and the corresponding
# setting int the template bblayers.conf.sample file)
# each time the layer settings are changed.
REQUIRED_TD_BBLAYERS_CONF_VERSION = "${DISTRO}-5"

LOCALCONF_VERSION = "2"


# Override these in poky based distros
ZUKIMO_DEFAULT_DISTRO_FEATURES = "largefile ptest multiarch systemd overlayfs overlayfs-etc usrmerge"
ZUKIMO_DEFAULT_EXTRA_RDEPENDS = "packagegroup-core-boot"
ZUKIMO_DEFAULT_EXTRA_RRECOMMENDS = "kernel-module-af-packet"

DISTRO_FEATURES ?= "${DISTRO_FEATURES_DEFAULT} ${ZUKIMO_DEFAULT_DISTRO_FEATURES}"
DISTRO_FEATURES:remove = "alsa bluetooth pcmcia wifi 3g x11 nfs"

PREFERRED_VERSION_linux-yocto ?= "6.1%"
PREFERRED_VERSION_linux-yocto-rt ?= "6.1%"

DISTRO_EXTRA_RDEPENDS += "${ZUKIMO_DEFAULT_EXTRA_RDEPENDS}"
DISTRO_EXTRA_RRECOMMENDS += "${ZUKIMO_DEFAULT_EXTRA_RRECOMMENDS}"

TCLIBCAPPEND = ""

INIT_MANAGER = "systemd"

require conf/distro/include/no-static-libs.inc
require conf/distro/include/yocto-uninative.inc
require conf/distro/include/security_flags.inc
INHERIT += "uninative"

BB_SIGNATURE_HANDLER ?= "OEEquivHash"
BB_HASHSERVE ??= "auto"
```

## conf/layer.conf
```bitbake
BBPATH =. "${LAYERDIR}:"
BBFILES += "${LAYERDIR}/recipes-*/*/*.bb ${LAYERDIR}/recipes-*/*/*.bbappend"

BBFILE_COLLECTIONS += "meta-zukimo"
BBFILE_PATTERN_meta-zukimo = "^${LAYERDIR}/"
BBFILE_PRIORITY_meta-zukimo = "50"

LAYERVERSION_meta-zukimo = "4"

LAYERDEPENDS_meta-zukimo = "core openembedded-layer"

LAYERSERIES_COMPAT_meta-zukimo = "nanbield kirkstone langdale"
```

## conf/machine/include/repovars.inc
```bitbake
ZUK_REPO_URLBASE_GITLAB = "git://gitlab.com/dreamchip"
ZUK_REPO_PROTOCOL_GITLAB = "https"
ZUK_REPO_URLBASE = "${ZUK_REPO_URLBASE_GITLAB}"
ZUK_REPO_PROTOCOL = "${ZUK_REPO_PROTOCOL_GITLAB}"

# ../../../recipes-kernel/dct-cpufreq/kernel-module-dct-cpufreq_1.0.bb
ZUK_REPO_NAME_CPUFREQ_GITLAB = "ip-sw-dct-cpufreq-driver"
ZUK_REPO_NAME_CPUFREQ = "${ZUK_REPO_NAME_CPUFREQ_GITLAB}"
ZUK_REPO_SRCREV_CPUFREQ = "v1-oss"
# ../../../recipes-kernel/dct-gpio/kernel-module-dct-gpio_1.0.bb
ZUK_REPO_NAME_GPIO_GITLAB = "ip-sw-dct-gpio-driver"
ZUK_REPO_NAME_GPIO = "${ZUK_REPO_NAME_GPIO_GITLAB}"
ZUK_REPO_SRCREV_GPIO = "v1-oss"
# ../../../recipes-kernel/dct-i2c/kernel-module-dct-i2c_1.0.bb
ZUK_REPO_NAME_I2C_GITLAB = "ip-sw-dct-i2c-driver"
ZUK_REPO_NAME_I2C = "${ZUK_REPO_NAME_I2C_GITLAB}"
ZUK_REPO_SRCREV_I2C = "v1-oss"
# ../../../recipes-kernel/dct-ipc/kernel-module-dct-ipc_1.0.bb
ZUK_REPO_NAME_IPC_GITLAB = "ip-sw-dct-ipc-driver"
ZUK_REPO_NAME_IPC = "${ZUK_REPO_NAME_IPC_GITLAB}"
ZUK_REPO_SRCREV_IPC = "v1-oss"
# ../../../recipes-kernel/dct-ipc-clk/kernel-module-dct-ipc-clk_1.0.bb
ZUK_REPO_NAME_IPC_CLK_GITLAB = "ip-sw-dct-ipc-clk-driver"
ZUK_REPO_NAME_IPC_CLK = "${ZUK_REPO_NAME_IPC_CLK_GITLAB}"
ZUK_REPO_SRCREV_IPC_CLK = "v1-oss"
# ../../../recipes-kernel/dct-ipc-gpio/kernel-module-dct-ipc-gpio_1.0.bb
ZUK_REPO_NAME_IPC_GPIO_GITLAB = "ip-sw-dct-ipc-gpio-driver"
ZUK_REPO_NAME_IPC_GPIO = "${ZUK_REPO_NAME_IPC_GPIO_GITLAB}"
ZUK_REPO_SRCREV_IPC_GPIO = "v1-oss"
# ../../../recipes-kernel/dct-irc5/kernel-module-dct-irc5_1.0.bb
ZUK_REPO_NAME_IRC5_GITLAB = "ip-sw-dct-irc5-driver"
ZUK_REPO_NAME_IRC5 = "${ZUK_REPO_NAME_IRC5_GITLAB}"
ZUK_REPO_SRCREV_IRC5 = "v1-oss"
# ../../../recipes-video/dct-isp-dma/kernel-module-dct-isp-dma_1.0.bb
ZUK_REPO_NAME_ISP_DMA_GITLAB = "ip-sw-dct-isp-dma-driver"
ZUK_REPO_NAME_ISP_DMA = "${ZUK_REPO_NAME_ISP_DMA_GITLAB}"
ZUK_REPO_SRCREV_ISP_DMA = "v1-oss"
# ../../../recipes-video/dct-isp-main/kernel-module-dct-isp-main_1.0.bb
ZUK_REPO_NAME_ISP_MAIN_GITLAB = "ip-sw-dct-isp-main-driver"
ZUK_REPO_NAME_ISP_MAIN = "${ZUK_REPO_NAME_ISP_MAIN_GITLAB}"
ZUK_REPO_SRCREV_ISP_MAIN = "v1-oss"
# ../../../recipes-video/dct-isp-pre/kernel-module-dct-isp-pre_1.0.bb
ZUK_REPO_NAME_ISP_PRE_GITLAB = "ip-sw-dct-isp-pre-driver"
ZUK_REPO_NAME_ISP_PRE = "${ZUK_REPO_NAME_ISP_PRE_GITLAB}"
ZUK_REPO_SRCREV_ISP_PRE = "v1-oss"
# ../../../recipes-video/dct-mvdu/kernel-module-dct-mvdu_1.0.bb
ZUK_REPO_NAME_MVDU_GITLAB = "ip-sw-dct-mvdu-driver"
ZUK_REPO_NAME_MVDU = "${ZUK_REPO_NAME_MVDU_GITLAB}"
ZUK_REPO_SRCREV_MVDU = "v1-oss"
# ../../../recipes-video/dct-nna/kernel-module-dct-nna_1.0.bb
ZUK_REPO_NAME_NNA_GITLAB = "ip-sw-dct-nna-driver"
ZUK_REPO_NAME_NNA = "${ZUK_REPO_NAME_NNA_GITLAB}"
ZUK_REPO_SRCREV_NNA = "v1-oss"
# ../../../recipes-kernel/dct-pcie/kernel-module-dct-pcie.bb
ZUK_REPO_NAME_PCIE_GITLAB = "ip-sw-dct-pcie-driver"
ZUK_REPO_NAME_PCIE = "${ZUK_REPO_NAME_PCIE_GITLAB}"
ZUK_REPO_SRCREV_PCIE = "v1-oss"
# ../../../recipes-kernel/dct-qspi/kernel-module-dct-qspi_1.0.bb
ZUK_REPO_NAME_QSPI_GITLAB = "ip-sw-dct-qspi-driver"
ZUK_REPO_NAME_QSPI = "${ZUK_REPO_NAME_QSPI_GITLAB}"
ZUK_REPO_SRCREV_QSPI = "v1-oss"
# ../../../recipes-kernel/dct-sdhci/kernel-module-dct-sdhci-cadence_1.0.bb
ZUK_REPO_NAME_SDHCI_CADENCE_GITLAB = "ip-sw-dct-sdhci-cadence-driver"
ZUK_REPO_NAME_SDHCI_CADENCE = "${ZUK_REPO_NAME_SDHCI_CADENCE_GITLAB}"
ZUK_REPO_SRCREV_SDHCI_CADENCE = "v1-oss"
```

## conf/machine/zukimo.conf
```bitbake
# Configuration for Zukimo platform

#@TYPE: Machine
#@NAME: Zukimo Base Platform machine
#@DESCRIPTION: Machine configuration for Zukimo platform

require conf/machine/include/repovars.inc

MACHINEOVERRIDES = "zukimo:${MACHINE}"

#MACHINE_FEATURES += "..."
# MACHINE_FEATURES += "rtc apm usbhost keyboard vfat ext2 screen touchscreen alsa bluetooth wifi sdio"

MACHINE_EXTRA_RRECOMMENDS += "kernel-modules"

DEFAULTTUNE = "cortexa65ae"
#TUNE_FEATURES = "cortexa65ae"

require conf/machine/include/arm/armv8-2a/tune-cortexa65ae.inc

# IMAGE_FSTYPES ?= "tar.bz2 ext4 wic wic.bz2 wic.bmap"
# WKS_FILE ?= "zukimo.wks"

IMAGE_FSTYPES ?= "tar.bz2 ext4"

ZUKIMO_KERNEL_DEVICETREE ?= " \
    dct/zukimo_pcie_rc.dtb \
"

ZUKIMO_KERNEL_DEVICETREEOVERLAYS = " \
"

SERIAL_CONSOLES = "115200;ttyDCT0"

PREFERRED_PROVIDER_virtual/kernel ?= "linux-yocto"
KERNEL_IMAGETYPE = "Image"
KERNEL_DEVICETREE = " \
    ${ZUKIMO_KERNEL_DEVICETREE} \
    ${ZUKIMO_KERNEL_DEVICETREEOVERLAYS} \
"
KERNEL_DEVICETREE_BASENAME = "${@os.path.basename(d.getVar('KERNEL_DEVICETREE'))}"

# The kernel image is installed into the FAT32 boot partition and does not need
# # to also be installed into the rootfs.
RDEPENDS:${KERNEL_PACKAGE_NAME}-base = ""

# u-boot configuration
UBOOT_MACHINE ?= "zukimo_defconfig"
PREFERRED_PROVIDER_u-boot-default-script = " u-boot-scr"

IMAGE_BOOT_FILES ?= " \
    boot.scr \
    u-boot.bin \
    ${KERNEL_IMAGETYPE}-${MACHINE}.bin \
    ${KERNEL_DEVICETREE_BASENAME} \
"

# do_image_wic[depends] += " \
#    u-boot-scr:do_deploy \
#    u-boot:do_deploy \
#    virtual/kernel:do_deploy \
# "
```

## conf/machine/zukimo_haps.conf
```bitbake
# Configuration for Zukimo HAPS platform

#@TYPE: Machine
#@NAME: Zukimo HAPS Platform machine
#@DESCRIPTION: Machine configuration for Zukimo HAPS platform

MACHINEOVERRIDES = "zukimo_haps:${MACHINE}"

ZUKIMO_KERNEL_DEVICETREE = " \
    dct/zukimo_haps.dtb \
"

UBOOT_MACHINE = "zukimo_haps_defconfig"

include conf/machine/zukimo.conf
```

## recipes-bsp/u-boot/files/zukimo_defconfig
```kconfig
CONFIG_ARM=y
CONFIG_ARCH_ZUKIMO=y
CONFIG_SYS_HAS_NONCACHED_MEMORY=y
CONFIG_SYS_NONCACHED_MEMORY=0x100000
CONFIG_SYS_CONFIG_NAME="zukimo"
# We have 512kB of internal SRAM:
# SRAM at 0x10000000 (0x10000000 - 0x10080000)
CONFIG_TEXT_BASE=0x10000000
CONFIG_SYS_MALLOC_LEN=0x1000000
CONFIG_SYS_MALLOC_F_LEN=0x2000
# Initial stack to top of SRAM:
CONFIG_HAS_CUSTOM_SYS_INIT_SP_ADDR=y
CONFIG_CUSTOM_SYS_INIT_SP_ADDR=0x1007c000
CONFIG_SYS_HAS_IPC_AREA=y
CONFIG_IPC_AREA_BASE=0x10068000
CONFIG_IPC_AREA_SIZE=0x8000
CONFIG_LINK_BSS_AREA_AFTER_IPC_AREA=y
# We have 2 banks of SDRAM:
# - 2GB at  0x80000000 ( 0x80000000 -  0xffffffff)
# - 6GB at 0x800000000 (0x800000000 - 0x8c0000000)
CONFIG_NR_DRAM_BANKS=2
CONFIG_COUNTER_FREQUENCY=125000000
CONFIG_ENV_SIZE=0x4000
CONFIG_ENV_SECT_SIZE=0x4000
CONFIG_IDENT_STRING=" zukimo"
CONFIG_SYS_LOAD_ADDR=0x80080000
CONFIG_BOOTDELAY=1
CONFIG_USE_BOOTARGS=y
# CONFIG_USE_BOOTCOMMAND is not set
# CONFIG_DISPLAY_CPUINFO is not set
CONFIG_SYS_PROMPT="Zukimo# "
CONFIG_DM_ETH=y
CONFIG_CMD_CACHE=y
CONFIG_DM=y
CONFIG_DM_SERIAL=y
CONFIG_OF_LIBFDT=y
CONFIG_ARCH_FIXUP_FDT_MEMORY=y
CONFIG_OF_LIBFDT_OVERLAY=y
# Use Uart 1 as separate debugging uart for psci and other services
CONFIG_DEBUG_UART=y
CONFIG_DEBUG_UART_ANNOUNCE=y
CONFIG_DEBUG_UART_DCT=y
# CONFIG_DEBUG_UART_BOARD_INIT is not set
CONFIG_DEBUG_UART_BASE=0x22090000
CONFIG_DEBUG_UART_CLOCK=25000000
CONFIG_LOG=y
CONFIG_LOG_MAX_LEVEL=4
CONFIG_LOG_DEFAULT_LEVEL=4
CONFIG_LOG_CONSOLE=y
CONFIG_LOGF_LINE=y
CONFIG_LOGF_FUNC=y
CONFIG_LOG_ERROR_RETURN=y
CONFIG_BOOTP_BOOTFILESIZE=y
CONFIG_REMAKE_ELF=y
# CONFIG_OF_BOARD is not set
CONFIG_OF_CONTROL=y
CONFIG_DEFAULT_DEVICE_TREE="zukimo"
CONFIG_OF_EMBED=y
CONFIG_CLK=y
# CONFIG_DISTRO_DEFAULTS is not set
# CONFIG_EFI_LOADER is not set
# CONFIG_EFI_PARTITION is not set
# CONFIG_MMC is not set
CONFIG_ARMV8_PSCI=y
CONFIG_ARMV8_PSCI_CPUS_PER_CLUSTER=2
# CONFIG_PSCI_RESET is not set
CONFIG_ARMV8_SWITCH_TO_EL1=y
CONFIG_ARMV8_SPL_EXCEPTION_VECTORS=y
CONFIG_ARMV8_EA_EL3_FIRST=y
# Allocate secure base at the upper 64k of internal SRAM:
CONFIG_SYS_HAS_ARMV8_SECURE_BASE=y
CONFIG_ARMV8_SECURE_BASE=0x1007c000
CONFIG_ARMV8_PSCI_RELOCATE=y
CONFIG_ARM_SMCCC=y
# Configure Memtest
CONFIG_CMD_MEMTEST=y
CONFIG_SYS_MEMTEST_START=0x800000000
CONFIG_SYS_MEMTEST_END=0x800100000
CONFIG_SYS_ALT_MEMTEST=y
CONFIG_SYS_ALT_MEMTEST_BITFLIP=y
# Configure MMC/SDHC
CONFIG_BLK=y
CONFIG_BLOCK_CACHE=y
CONFIG_MMC=y
CONFIG_MMC_WRITE=y
CONFIG_DM_MMC=y
CONFIG_MMC_SDHCI_ADMA_HELPERS=y
CONFIG_MMC_QUIRKS=y
CONFIG_SYS_MMC_MAX_BLK_COUNT=256
CONFIG_MMC_HW_PARTITIONING=y
CONFIG_MMC_IO_VOLTAGE=y
CONFIG_MMC_UHS_SUPPORT=y
CONFIG_MMC_HS200_SUPPORT=y
CONFIG_CMD_DM=y
CONFIG_CMD_MMC=y
CONFIG_MMC_TRACE=n
CONFIG_MMC_VERBOSE=y
# CONFIG_MMC_DCT_SDHC=n
CONFIG_MMC_SDHCI=y
CONFIG_MMC_SDHCI_ADMA=y
CONFIG_MMC_DCT_SDHCI_CADENCE=y
# Configure Network
CONFIG_ETH=y
CONFIG_NET=y
CONFIG_MII=y
CONFIG_PHYLIB=y
CONFIG_PHY_ADIN=y
CONFIG_DM_MDIO=y
CONFIG_DM_ETH_PHY=y
CONFIG_DM_ETH=y
CONFIG_CMD_BOOTP=y
CONFIG_NETDEVICES=y
CONFIG_MACB=y
CONFIG_CMD_NET=y
CONFIG_CMD_TFTPBOOT=y
CONFIG_CMD_PING=y
CONFIG_CMD_MII=y
CONFIG_CMD_MDIO=y
CONFIG_PROT_UDP=y
CONFIG_PROT_TCP=n
CONFIG_SYS_RX_ETH_BUFFER=4
CONFIG_CMD_DHCP=y
CONFIG_NET_RANDOM_ETHADDR=y
# Configure GPIO
CONFIG_DM_GPIO=y
CONFIG_DCT_IPC_GPIO=y
CONFIG_CMD_GPIO=y
CONFIG_CMD_GPIO_READ=y
# Configure REGULATOR
CONFIG_CMD_REGULATOR=y
CONFIG_DM_REGULATOR=y
CONFIG_DM_REGULATOR_GPIO=y
# Configure FAT file system support
CONFIG_CMD_FAT=y
CONFIG_FS_FAT=y
CONFIG_FAT_WRITE=y
CONFIG_ENV_IS_IN_FAT=y
CONFIG_ENV_FAT_DEVICE_AND_PART="0"
CONFIG_SYS_CBSIZE=1024
CONFIG_DM_RESET=y
CONFIG_RESET_DCT_ZUKIMO=y
```

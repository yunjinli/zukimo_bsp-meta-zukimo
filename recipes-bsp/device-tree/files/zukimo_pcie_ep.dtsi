&{/} {

	// Zukimo Register Map (A65)
	//
	// Subsystems (reserved address range for work in progress sub-systems)
	// 	0x0_2980_0000	8M		HPIO.PCIe	- No IPXACT descriptions for controller and phy yet available (solvenet ticket to be filed)
	//
	// MMIO - PCIe remote memory access
	// 	0x0_4000_0000	1GB		MMIO (low) 	- Remote memory access via PCIe
	// 	0x4_0000_0000	16GB	MMIO (high) - Remote memory via access PCIe / 32bit address masters (APU_DMA/NNA/NPU) with address LUT support

	soc: soc {

		pcie_ep0: pcie_ep@24070000 {
			compatible = "dct,pcie-ep";
			reg = <	0x00000000 0x24070000 0x00000000 0x00001000
					0x00000000 0x29800000 0x00000000 0x00001000
					0x00000000 0x29801000 0x00000000 0x00001000
					0x00000000 0x29b00000 0x00000000 0x00001000
					0x00000000 0x40000000 0x00000000 0x40000000>;
			reg-names = "ctl\0dbi\0dbi2\0atu\0addr_space";

			interrupt-parent = <&gic>;
			interrupts = <	GIC_SPI 150 IRQ_TYPE_LEVEL_HIGH
							GIC_SPI 151 IRQ_TYPE_LEVEL_HIGH >;
			interrupt-names = "error\0ctl";

			// clocks = <&cpg CPG_MOD 624>;
			// power-domains = <&sysc R8A779G0_PD_ALWAYS_ON>;
			// resets = <&cpg 624>;
			// resize-bar = <0>;

			pcie-perstn-gpios = <&dct_gpio 0 0>;
			pcie-clkreqn-gpios = <&dct_gpio 1 0>;
			pcie-waken-gpios = <&dct_gpio 2 0>;

			max-functions = /bits/ 8 <0x01>;

			num-lanes = <0x04>;
			max-link-speed = <0x03>;
			status = "disabled";
		};
	};
};
